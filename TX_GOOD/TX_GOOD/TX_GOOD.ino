#include <TimerOne.h>
#include <avr/pgmspace.h>

/* Pin Delarations */
#define TX_PIN  13

/* Other Constants */
#define TIMER_PERIOD     500 // microseconds, originally 10000
#define BITS_PER_BYTE       8


/* Globals Variables */
//byte message[] = "__It sure is nice when things are working the way they should.\n";

const unsigned char message[] PROGMEM = {
    0xe9, 0xe9, 0xe9, 0xa9, 0xe0, 0xe0, 0xe0, 0xc0, 0xc9, 0x40, 0xc9, 0x00, 0xe9, 0xe9, 0xe9, 0xe9, 0x29, 0x40, 0x89, 0xe0, 0x00, 0x69, 0xa0, 0x05, 
    0x89, 0x20, 0x09, 0x00, 0x49, 0x20, 0x89, 0x20, 0x69, 0xe0, 0xe0, 0xe0,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 0x05, 
    0xe9, 0xe9, 0xe9, 0xa9, 0xe0, 0xe0, 0x60, 0x09, 0x00, 0x49, 0x03, 0x0c,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 0x05, 
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    0xe6, 0xe6, 0xe6, 0x06, 0x0d, 0x08, 0xe1, 0xa1, 0x68, 0x6d, 0x31, 0x2a,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 0x05
};

#define N_SYNC 500

unsigned int messageLength = sizeof(message);
int byteIndex = 0;
int bitIndex = 0;
int debug = 0;
boolean synced = false;
byte sync1 = 0xFF;
byte sync2 = 0;
int sync_frames = 0;
byte byte_to_send;


/* Initializations */
void setup() 
{
  int i = 0;        
  pinMode(TX_PIN, OUTPUT); 
  Serial.begin(9600);  
  
  /* Set Timer1 to run transmitNextBit() every TIMER_PERIOD microseconds */
  Timer1.initialize(TIMER_PERIOD);         
  Timer1.attachInterrupt(transmitNextBit); 
  
  /* Intialize start of message sequence. */
  //message[0] = 0b11111111;
  //message[1] = 0b11111111;

}


/* Main function (unused in this program) */
void loop() {}


/* Timer Interrupt Service Routine */
void transmitNextBit()
{
  if( !synced ) {
    if ( sync_frames % 2 == 0 ) {
      byte_to_send = sync1;
    } else {
      byte_to_send = sync2;
    }
    
    digitalWrite(TX_PIN, (byte_to_send >> (7 - bitIndex)) & 1);
    bitIndex++;
    
    if( bitIndex == BITS_PER_BYTE ) {
      bitIndex = 0;
      sync_frames++;
      if ( sync_frames >= N_SYNC ) {
        synced = true;
      }
    }

    
  } else {
    /* Determine next bit to transmit. */
    byte the_byte = pgm_read_byte_near(message + byteIndex);
    
    /* Trasmit the next bit */
    /*//digitalWrite(TX_PIN, bit);*/
    digitalWrite(TX_PIN, (the_byte >> (7 - bitIndex)) & 1);
    bitIndex++;
    if(bitIndex == BITS_PER_BYTE)
    {    
      bitIndex = 0;
      byteIndex++;
      if(byteIndex == messageLength)
        byteIndex = 0;
    }
  }
}  

